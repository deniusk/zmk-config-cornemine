## boards/shields/cornehwd/Kconfig.defconfig
```kconfig
if SHIELD_CORNEHWD_LEFT

config ZMK_KEYBOARD_NAME
    default "cornehwd"

config ZMK_SPLIT_ROLE_CENTRAL
    default y

endif # SHIELD_CORNEHWD_LEFT

if SHIELD_CORNEHWD_LEFT || SHIELD_CORNEHWD_RIGHT

config ZMK_SPLIT
    default y

endif # SHIELD_CORNEHWD_LEFT || SHIELD_CORNEHWD_RIGHT
```

## boards/shields/cornehwd/Kconfig.shield
```kconfig
config SHIELD_CORNEHWD_LEFT
    def_bool $(shields_list_contains,cornehwd_left)

config SHIELD_CORNEHWD_RIGHT
    def_bool $(shields_list_contains,cornehwd_right)
```
