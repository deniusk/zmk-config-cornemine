#include "cornehwd.dtsi"

&kscan {
    row-gpios = <
        &gpio1 15 GPIO_ACTIVE_HIGH
        &gpio1 13 GPIO_ACTIVE_HIGH
        &gpio1 11 GPIO_ACTIVE_HIGH
        &gpio0 10 GPIO_ACTIVE_HIGH
    >;  

    col-gpios = <
        &gpio1 4  (GPIO_ACTIVE_HIGH | GPIO_PULL_DOWN)
        &gpio0 11 (GPIO_ACTIVE_HIGH | GPIO_PULL_DOWN)
        &gpio1 0  (GPIO_ACTIVE_HIGH | GPIO_PULL_DOWN)
        &gpio0 24 (GPIO_ACTIVE_HIGH | GPIO_PULL_DOWN)
        &gpio0 22 (GPIO_ACTIVE_HIGH | GPIO_PULL_DOWN)
        &gpio0 20 (GPIO_ACTIVE_HIGH | GPIO_PULL_DOWN)
    >;
};

&default_transform {
    col-offset = <0>;
};